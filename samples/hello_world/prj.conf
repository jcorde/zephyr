## prj.conf
```kconfig
# nothing here
# Logging
CONFIG_LOG=y
CONFIG_LOG_PRINTK=y
CONFIG_LOG_IMMEDIATE=y

# USB
CONFIG_USB=y
CONFIG_USB_DEVICE_STACK=y
CONFIG_USB_CDC_ACM=y
CONFIG_USB_UART_CONSOLE=y
CONFIG_USB_DEVICE_PRODUCT="KNoT Thing"
CONFIG_USB_MASS_STORAGE=n

# Use console and shell for output
CONFIG_CONSOLE=y
CONFIG_STDOUT_CONSOLE=y

CONFIG_UART_CONSOLE=y
CONFIG_UART_SHELL_ON_DEV_NAME="CDC_ACM_0"

CONFIG_SERIAL=y

# Disable shell input options
CONFIG_SHELL=y

# Using OT
CONFIG_REBOOT=y
CONFIG_CPLUSPLUS=y

CONFIG_FLASH=y
CONFIG_FLASH_PAGE_LAYOUT=y

CONFIG_NETWORKING=y
CONFIG_NET_L2_OPENTHREAD=y
```

## src/main.c
```c
/*
 * Copyright (c) 2012-2014 Wind River Systems, Inc.
 *
 * SPDX-License-Identifier: Apache-2.0
 */

#include <zephyr.h>
#include <misc/printk.h>

void main(void)
{
	while(1) {
		printk("Hello World! %s\n", CONFIG_BOARD);
		k_sleep(1000);
	}
}
```
