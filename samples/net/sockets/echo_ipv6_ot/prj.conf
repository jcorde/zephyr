## prj.conf
```kconfig
# Generic networking options
CONFIG_NETWORKING=y
# CONFIG_NET_UDP=n
CONFIG_NET_UDP=y
CONFIG_NET_TCP=y
CONFIG_NET_IPV6=y
CONFIG_NET_IPV4=n
CONFIG_NET_SOCKETS=y
CONFIG_NET_SOCKETS_POSIX_NAMES=y
CONFIG_NET_SOCKETS_POLL_MAX=4

# Kernel options
CONFIG_MAIN_STACK_SIZE=2048
CONFIG_ENTROPY_GENERATOR=y
CONFIG_TEST_RANDOM_GENERATOR=y
CONFIG_INIT_STACKS=y

# Logging
CONFIG_NET_LOG=y
CONFIG_LOG=y
CONFIG_NET_STATISTICS=y
CONFIG_PRINTK=y

# Network buffers
CONFIG_NET_PKT_RX_COUNT=16
CONFIG_NET_PKT_TX_COUNT=16
CONFIG_NET_BUF_RX_COUNT=80
CONFIG_NET_BUF_TX_COUNT=80
CONFIG_NET_CONTEXT_NET_PKT_POOL=y

# IP address options
CONFIG_NET_IF_UNICAST_IPV6_ADDR_COUNT=3
CONFIG_NET_IF_MCAST_IPV6_ADDR_COUNT=4
CONFIG_NET_MAX_CONTEXTS=10

# Network shell
CONFIG_NET_SHELL=y

# The addresses are selected so that qemu<->qemu connectivity works ok.
# For linux<->qemu connectivity, create a new conf file and swap the
# addresses (so that peer address is ending to 2).
CONFIG_NET_CONFIG_SETTINGS=y
CONFIG_NET_CONFIG_MY_IPV6_ADDR="2001:db8::2"
CONFIG_NET_CONFIG_PEER_IPV6_ADDR="2001:db8::1"
CONFIG_NET_CONFIG_MY_IPV4_ADDR="192.0.2.2"
CONFIG_NET_CONFIG_PEER_IPV4_ADDR="192.0.2.1"
```

## overlay-ot.conf
```kconfig
CONFIG_CPLUSPLUS=y

CONFIG_BT=n

# Disable TCP and IPv4 (TCP disabled to avoid heavy traffic)
CONFIG_NET_TCP=y
CONFIG_NET_IPV4=n
CONFIG_NET_IPV6=y

CONFIG_NET_IPV6_NBR_CACHE=n
CONFIG_NET_IPV6_MLD=n
CONFIG_NET_CONFIG_NEED_IPV6=y
CONFIG_NET_CONFIG_NEED_IPV4=n
CONFIG_NET_CONFIG_MY_IPV4_ADDR=""
CONFIG_NET_CONFIG_PEER_IPV4_ADDR=""

CONFIG_SYSTEM_WORKQUEUE_STACK_SIZE=2048
CONFIG_NET_TX_STACK_SIZE=2048
CONFIG_NET_RX_STACK_SIZE=5120
CONFIG_SHELL_STACK_SIZE=3072

CONFIG_NET_L2_OPENTHREAD=y

CONFIG_OPENTHREAD_DEBUG=y
CONFIG_OPENTHREAD_L2_DEBUG=y
CONFIG_OPENTHREAD_L2_LOG_LEVEL_INF=y

CONFIG_OPENTHREAD_CHANNEL=11
CONFIG_OPENTHREAD_PANID=4369
CONFIG_OPENTHREAD_NETWORK_NAME="knot"
CONFIG_OPENTHREAD_XPANID="11:11:11:11:22:22:22:22"
CONFIG_NET_CONFIG_PEER_IPV6_ADDR="fd11:1111:1122:0:3230:c94d:31f2:9e39"
CONFIG_OPENTHREAD_MTD=y

# Thread by default registers quite a lot addresses.
CONFIG_NET_IF_UNICAST_IPV6_ADDR_COUNT=6
CONFIG_NET_IF_MCAST_IPV6_ADDR_COUNT=8

# Other OpenThread dependencies (flash for OT persistent storage)
CONFIG_FLASH=y
CONFIG_FLASH_PAGE_LAYOUT=y
CONFIG_MPU_ALLOW_FLASH_WRITE=y

CONFIG_REBOOT=y



# CONFIG_OT_PLAT_FLASH_PAGES_COUNT=4





CONFIG_UART_INTERRUPT_DRIVEN=n
CONFIG_UART_0_NRF_UARTE=n
CONFIG_UART_0_INTERRUPT_DRIVEN=n



CONFIG_SHELL_BACKEND_SERIAL_INTERRUPT_DRIVEN=n
```

## src/common.h
```c
/*
 * Copyright (c) 2017 Intel Corporation.
 * Copyright (c) 2018 Nordic Semiconductor ASA.
 *
 * SPDX-License-Identifier: Apache-2.0
 */

/* Value of 0 will cause the IP stack to select next free port */
#define MY_PORT 0

#define PEER_PORT 4242

struct data {
	const char *proto;

	struct {
		int sock;
		/* Work controlling udp data sending */
		struct k_delayed_work recv;
		struct k_delayed_work transmit;
		u32_t expecting;
		u32_t counter;
	} udp;

	struct {
		int sock;
		u32_t expecting;
		u32_t received;
		u32_t counter;
	} tcp;
};

struct configs {
	struct data ipv4;
	struct data ipv6;
};

extern const char lorem_ipsum[];
extern const int ipsum_len;
extern struct configs conf;

int start_udp(void);
int process_udp(void);
void stop_udp(void);

int start_tcp(void);
int process_tcp(void);
void stop_tcp(void);

int send_data_mod(void);
```

## src/echo-client.c
```c
/* echo-client.c - Networking echo client */

/*
 * Copyright (c) 2017 Intel Corporation.
 * Copyright (c) 2018 Nordic Semiconductor ASA.
 *
 * SPDX-License-Identifier: Apache-2.0
 */

/*
 * The echo-client application is acting as a client that is run in Zephyr OS,
 * and echo-server is run in the host acting as a server. The client will send
 * either unicast or multicast packets to the server which will reply the packet
 * back to the originator.
 *
 * In this sample application we create four threads that start to send data.
 * This might not be what you want to do in your app so caveat emptor.
 */

#include <logging/log.h>
LOG_MODULE_REGISTER(net_echo_client_sample, LOG_LEVEL_DBG);

#include <zephyr.h>
#include <errno.h>
#include <stdio.h>

#include <net/socket.h>
#include <net/net_config.h>

#include "common.h"

#define APP_BANNER "Run echo client"

#define INVALID_SOCK (-1)

/* Generated by http://www.lipsum.com/
 * 2 paragraphs, 179 words, 1160 bytes of Lorem Ipsum
 */
const char lorem_ipsum[] =
	"Lorem ipsum dolor sit amet, consectetur adipiscing elit. Quisque "
	"sodales lorem lorem, sed congue enim vehicula a. Sed finibus diam sed "
	"odio ultrices pharetra. Nullam dictum arcu ultricies turpis congue, "
	"vel venenatis turpis venenatis. Nam tempus arcu eros, ac congue libero "
	"tristique congue. Proin velit lectus, euismod sit amet quam in, "
	"maximus condimentum urna. Cras vel erat luctus, mattis orci ut, varius "
	"urna. Nam eu lobortis velit."
	"\n"
	"Nullam sit amet diam vel odio sodales cursus vehicula eu arcu. Proin "
	"fringilla, enim nec consectetur mollis, lorem orci interdum nisi, "
	"vitae suscipit nisi mauris eu mi. Proin diam enim, mollis ac rhoncus "
	"vitae, placerat et eros. Suspendisse convallis, ipsum nec rhoncus "
	"aliquam, ex augue ultrices nisl, id aliquet mi diam quis ante. "
	"Pellentesque venenatis ornare ultrices. Quisque et porttitor lectus. "
	"Ut venenatis nunc et urna imperdiet porttitor non laoreet massa. Donec "
	"eleifend eros in mi sagittis egestas. Sed et mi nunc. Nunc vulputate, "
	"mauris non ullamcorper viverra, lorem nulla vulputate diam, et congue "
	"dui velit non erat. Duis interdum leo et ipsum tempor consequat. In "
	"faucibus enim quis purus vulputate nullam."
	"\n";

const int ipsum_len = sizeof(lorem_ipsum) - 1;

struct configs conf = {
	.ipv6 = {
		.proto = "IPv6",
		.udp.sock = INVALID_SOCK,
		.tcp.sock = INVALID_SOCK,
	},
};

static struct pollfd fds;

static volatile bool in_process = false;


static void prepare_fds(void)
{
	if (conf.ipv6.tcp.sock >= 0) {
		fds.fd = conf.ipv6.tcp.sock;
		fds.events = POLLIN|POLLOUT|POLLERR|POLLHUP|POLLNVAL;
	}
}

static int wait_event( int timeout)
{
	int ret;
	/*
	 * Check if any event occurred on fds poll fds.
	 */
	ret = poll(&fds, 1, timeout);
	if ( ret < 0 ) {
		LOG_ERR("Error in poll:%d", errno);
		goto done;
	}

	if(fds.revents & POLLIN) {
		LOG_INF("Event IN");
		if (in_process == false) {
			in_process = true;
		}

	}

	if(fds.revents & POLLHUP) {
		LOG_INF("Event HUP");
	}

	if(fds.revents & POLLOUT) {
		LOG_INF("Event OUT");
	}

	if(fds.revents & POLLERR) {
		LOG_INF("Event ERR");
	}

	LOG_INF("Got event %d",fds.revents);

done:
	return ret;
}

void main(void)
{
	int ret;

	LOG_INF(APP_BANNER);

reconnect:

	LOG_INF("Call start_tcp");
	ret = start_tcp();
	if (ret < 0)
		goto quit;


	send_data_mod();

	prepare_fds();

	while (true) {
		// avoid call process_tcp() twice
		if ( in_process == true)
		{
			LOG_INF("Call process_tcp");
			ret = process_tcp();
			in_process = false;
			if (ret < 0)
				goto quit;

		}
		wait_event(-1);
	}

quit:
	LOG_INF("Stopping...");
	stop_tcp();

	k_sleep(5000);
	LOG_INF("Reconnecting...");
	goto reconnect;
}
```

## src/tcp.c
```c
/* tcp.c - TCP specific code for echo client */

/*
 * Copyright (c) 2017 Intel Corporation.
 * Copyright (c) 2018 Nordic Semiconductor ASA.
 *
 * SPDX-License-Identifier: Apache-2.0
 */

#include <logging/log.h>
LOG_MODULE_DECLARE(net_echo_client_sample, LOG_LEVEL_DBG);

#include <zephyr.h>
#include <errno.h>
#include <stdio.h>

#include <net/socket.h>

#include "common.h"

#define RECV_BUF_SIZE 128

static ssize_t sendall(const void *buf, size_t len)
{
	while (len) {
		ssize_t out_len = send(conf.sock, buf, len, 0);

		if (out_len < 0) {
			return out_len;
		}
		buf = (const char *)buf + out_len;
		len -= out_len;
	}

	return 0;
}

static int send_tcp_data(void)
{
	int ret;

	do {
		conf.expecting = sys_rand32_get() % ipsum_len;
	} while (conf.expecting == 0);

	conf.received = 0U;

	ret =  sendall(lorem_ipsum, conf.expecting);

	if (ret < 0)
		LOG_ERR("TCP: Failed to send data, errno %d", errno);
	else
		LOG_DBG("TCP: Sent %d bytes", conf.expecting);

	return ret;
}

int send_data_mod(void)
{
	return send_tcp_data();
}

static int compare_tcp_data(const char *buf, u32_t received)
{
	if (conf.received + received > conf.expecting) {
		LOG_ERR("Too much data received: TCP");
		return -EIO;
	}

	if (memcmp(buf, lorem_ipsum + conf.received, received) != 0) {
		LOG_ERR("Invalid data received: TCP");
		return -EIO;
	}

	return 0;
}

static int start_tcp_proto(struct sockaddr *addr,
			   socklen_t addrlen)
{
	int ret;

	conf.sock = socket(addr->sa_family, SOCK_STREAM, IPPROTO_TCP);
	if (conf.sock < 0) {
		LOG_ERR("Failed to create TCP socket: %d", errno);
		return -errno;
	}

	ret = connect(conf.sock, addr, addrlen);
	if (ret < 0) {
		LOG_ERR("Cannot connect to TCP remote: %d", errno);
		ret = -errno;
	}

	return ret;
}

static int process_tcp_proto(void)
{
	int ret, received;
	char buf[RECV_BUF_SIZE];

	do {
		received = recv(conf.sock, buf, sizeof(buf), MSG_DONTWAIT);

		/* No data or error. */
		if (received == 0) {
			ret = -EIO;
			continue;
		} else if (received < 0) {
			if (errno == EAGAIN || errno == EWOULDBLOCK) {
				ret = 0;
			} else {
				ret = -errno;
			}
			continue;
		}

		ret = compare_tcp_data(buf, received);
		if (ret != 0) {
			break;
		}

		/* Successful comparison. */
		conf.received += received;
		if (conf.received < conf.expecting) {
			continue;
		}

		/* Response complete */
		LOG_DBG("TCP: Received and compared %d bytes, all ok",
			conf.received);


		if (++conf.counter % 1000 == 0) {
			LOG_INF("TCP: Exchanged %u packets", conf.counter);
		}
		k_sleep(1000);
		ret = send_tcp_data();
		break;
	} while (received > 0);

	return ret;
}

int start_tcp(void)
{
	int ret = 0;
	struct sockaddr_in6 addr6;

	addr6.sin6_family = AF_INET6;
	addr6.sin6_port = htons(PEER_PORT);
	ret = inet_pton(AF_INET6, CONFIG_NET_CONFIG_PEER_IPV6_ADDR,
			&addr6.sin6_addr);
	if ( ret <= 0)
		return -EFAULT;

	ret = start_tcp_proto((struct sockaddr *)&addr6,
				sizeof(addr6));
	if (ret < 0) {
		return ret;
	}

	return ret;
}

int process_tcp(void)
{
	int ret = 0;

	ret = process_tcp_proto();
	if (ret < 0) {
		return ret;
	}

	return ret;
}

void stop_tcp(void)
{
	if (conf.sock >= 0) {
		(void)close(conf.sock);
	}
}
```
